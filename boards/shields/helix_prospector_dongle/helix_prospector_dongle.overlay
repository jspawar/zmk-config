#include <dt-bindings/zmk/matrix_transform.h>

/ {
    chosen {
        zmk,kscan = &mock_kscan;
	zmk,matrix_transform = &default_transform;
    };

    mock_kscan: mock_kscan_0 {
        compatible = "zmk,kscan-mock";
        columns = <0>;
        rows = <0>;
        events = <0>;
    };

    default_transform: keymap_transform_0 {
        compatible = "zmk,matrix-transform";
	// TODO: copy columns, rows value from upstream Helix config
        columns = <14>;
        rows = <5>;

	// TODO: copy the layout from upstream Helix config
        map = <
            // Lots of RC(r,c) macros
        >;
    };
};
